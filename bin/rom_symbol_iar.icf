define exported symbol get_active_ota_bank_addr = 0x000011cd;
define exported symbol SHA256_Init = 0x00001a17;
define exported symbol SHA256_Update = 0x00001a33;
define exported symbol SHA256_Final = 0x00001ab3;
define exported symbol SHA256_Alloc = 0x00001bf7;
define exported symbol SHA256_Free = 0x00001c37;
define exported symbol SHA256 = 0x00001c3b;
define exported symbol RamVectorTableInit = 0x00004ca9;
define exported symbol RamVectorTableUpdate = 0x00004ccb;
define exported symbol LOGUARTDriverInit = 0x00005231;
define exported symbol dump_raw_memory_all = 0x00006df5;
define exported symbol hardfault_print_buffered_log = 0x00006ee5;
define exported symbol SystemCall = 0x000072a1;
define exported symbol btxfcs = 0x000073d5;
define exported symbol platform_random = 0x000077b3;
define exported symbol platform_ramdom_seed_update = 0x000077c7;
define exported symbol LogUartTxChar = 0x00007935;
define exported symbol log_timestamp_get = 0x00007975;
define exported symbol log_direct = 0x000079b1;
define exported symbol log_buffer = 0x00007a5f;
define exported symbol log_index = 0x00007b97;
define exported symbol log_snoop = 0x00007c93;
define exported symbol trace_bdaddr = 0x00007dd9;
define exported symbol trace_string = 0x00007e6b;
define exported symbol trace_binary = 0x00007f0b;
define exported symbol LogBufferLowerStack = 0x00007fa9;
define exported symbol LogBufferLowerStackData = 0x000080bb;
define exported symbol log_module_trace_init = 0x000081d5;
define exported symbol log_module_trace_set = 0x000081fd;
define exported symbol log_module_bitmap_trace_set = 0x00008243;
define exported symbol dlps_check_cb_reg = 0x000085ff;
define exported symbol dlps_hw_control_cb_reg = 0x000086ef;
define exported symbol dlps_hw_control_cb_unreg = 0x00008729;
define exported symbol lps_mode_pause = 0x00008825;
define exported symbol lps_mode_resume = 0x00008841;
define exported symbol lps_mode_set = 0x0000885f;
define exported symbol lps_mode_get = 0x0000886f;
define exported symbol lps_mode_stack_get = 0x00008875;
define exported symbol hw_aes_encrypt128 = 0x00008abb;
define exported symbol hw_aes_decrypt128 = 0x00008adf;
define exported symbol hw_aes_encrypt256 = 0x00008aff;
define exported symbol hw_aes_decrypt256 = 0x00008b23;
define exported symbol hw_aes_encrypt128_use_dma = 0x00008b47;
define exported symbol hw_aes_decrypt128_use_dma = 0x00008b77;
define exported symbol hw_aes_encrypt256_use_dma = 0x00008ba7;
define exported symbol hw_aes_decrypt256_use_dma = 0x00008bd7;
define exported symbol aes128_ecb_encrypt = 0x00008c07;
define exported symbol aes128_ecb_decrypt = 0x00008c63;
define exported symbol aes128_ecb_encrypt_msb2lsb = 0x00008cbd;
define exported symbol aes128_ecb_decrypt_msb2lsb = 0x00008cd5;
define exported symbol aes256_ecb_encrypt = 0x00008ced;
define exported symbol aes256_ecb_decrypt = 0x00008d49;
define exported symbol aes256_ecb_encrypt_msb2lsb = 0x00008da3;
define exported symbol aes256_ecb_decrypt_msb2lsb = 0x00008dbb;
define exported symbol hw_aes_decrypt_code_init_slim = 0x00008de5;
define exported symbol hw_aes_decrypt_16byte = 0x00008e11;
define exported symbol BTIF_VendorGetResponse = 0x00008f65;
define exported symbol spic_wait_busy = 0x00009051;
define exported symbol flash_cmd_rx = 0x0000929d;
define exported symbol flash_wait_busy = 0x0000932f;
define exported symbol flash_cmd_tx = 0x00009369;
define exported symbol flash_write_enable = 0x00009421;
define exported symbol flash_get_status_regs = 0x0000956f;
define exported symbol flash_set_status_regs = 0x000095e5;
define exported symbol flash_get_rdid = 0x00009905;
define exported symbol flash_load_query_info = 0x00009d4b;
define exported symbol flash_erase = 0x00009e01;
define exported symbol flash_lock = 0x0000a103;
define exported symbol flash_unlock = 0x0000a1ab;
define exported symbol flash_set_bit = 0x0000a237;
define exported symbol flash_get_bit = 0x0000a23f;
define exported symbol flash_write_internal = 0x0000a24b;
define exported symbol flash_read = 0x0000a359;
define exported symbol flash_split_read = 0x0000a39d;
define exported symbol flash_auto_write = 0x0000a4cd;
define exported symbol flash_get_block_protect = 0x0000a53b;
define exported symbol flash_set_block_protect = 0x0000a58f;
define exported symbol flash_sw_protect_unlock_by_addr = 0x0000a637;
define exported symbol flash_set_top_bottom = 0x0000a803;
define exported symbol flash_get_query_info = 0x0000a9a9;
define exported symbol spic_get_dr = 0x0000aad1;
define exported symbol spic_set_dummy_len = 0x0000aaeb;
define exported symbol flash_read_internal = 0x0000ab45;
define exported symbol ftl_ioctl = 0x0000b3a7;
define exported symbol ftl_load = 0x0000b907;
define exported symbol ftl_save = 0x0000b919;
define exported symbol hardfault_dump = 0x0000bb21;
define exported symbol flash_dump_flash_info = 0x0000beb9;
define exported symbol crc16 = 0x0000bf13;
define exported symbol flash_get_flash_exist = 0x0000bf3b;
define exported symbol flash_get_bank_addr = 0x0000bf41;
define exported symbol flash_get_bank_size = 0x0000bfb9;
define exported symbol flash_erase_locked = 0x0000c027;
define exported symbol flash_ioctl = 0x0000c073;
define exported symbol flash_write_locked = 0x0000c48b;
define exported symbol flash_auto_write_locked = 0x0000c4b3;
define exported symbol flash_auto_write_buffer_locked = 0x0000c4d5;
define exported symbol flash_read_locked = 0x0000c4fb;
define exported symbol flash_auto_read_locked = 0x0000c523;
define exported symbol flash_ds_erase = 0x0000c5c7;
define exported symbol flash_ds_auto_write = 0x0000c5e3;
define exported symbol flash_ds_auto_read = 0x0000c5fd;
define exported symbol flash_ds_write = 0x0000c617;
define exported symbol flash_ds_read = 0x0000c635;
define exported symbol set_hci_mode_flag = 0x0000c741;
define exported symbol check_hci_mode_flag = 0x0000c761;
define exported symbol set_datatrans_patch_flag = 0x0000c76d;
define exported symbol check_datatrans_patch_flag = 0x0000c78d;
define exported symbol check_image_chksum = 0x0000c79d;
define exported symbol check_header_valid = 0x0000c7a9;
define exported symbol get_header_addr_by_img_id = 0x0000c7e5;
define exported symbol is_ota_support_bank_switch = 0x0000c843;
define exported symbol get_temp_ota_bank_addr_by_img_id = 0x0000c881;
define exported symbol vListInitialise = 0x0000c941;
define exported symbol vListInitialiseItem = 0x0000c957;
define exported symbol vListInsertEnd = 0x0000c95d;
define exported symbol vListInsert = 0x0000c975;
define exported symbol uxListRemove = 0x0000c9a5;
define exported symbol xQueueGenericSend = 0x0000cb85;
define exported symbol xQueueGenericSendFromISR = 0x0000cf87;
define exported symbol xTaskGenericNotify = 0x0000e42d;
define exported symbol xTaskGenericNotifyFromISR = 0x0000e4e3;
define exported symbol vTaskStatusDump = 0x0000e6ab;
define exported symbol rtlEnterCritical = 0x0000f421;
define exported symbol rtlExitCritical = 0x0000f451;
define exported symbol pvPortMalloc = 0x0000f70b;
define exported symbol vPortFree = 0x0000f817;
define exported symbol hw_aes_init = 0x00010c21;
define exported symbol hw_aes_cpu_operate = 0x00010d91;
define exported symbol hw_aes_set_dma_tx_done = 0x00010d9d;
define exported symbol hw_aes_set_dma_rx_done = 0x00010da3;
define exported symbol hw_aes_dma_operate = 0x00010da9;
define exported symbol hw_aes_is_dma_rx_done = 0x00011005;
define exported symbol hw_aes_is_dma_tx_done = 0x0001100b;
define exported symbol hw_aes_dma_done = 0x00011011;
define exported symbol hw_aes_set_dma_move_src = 0x0001101b;
define exported symbol hw_aes_set_dma_move_dst = 0x00011021;
define exported symbol hw_aes_set_dma_carry_size = 0x00011027;
define exported symbol aes_cmac_inverse = 0x0001119b;
define exported symbol get_secure_reg_cfg_val = 0x00011269;
define exported symbol NVIC_Init = 0x000112c1;
define exported symbol Pinmux_Config = 0x00011375;
define exported symbol Pinmux_Deinit = 0x000113a9;
define exported symbol Pinmux_Reset = 0x000113c5;
define exported symbol Pad_Config = 0x000113dd;
define exported symbol System_WakeUpDebounceTime = 0x0001146b;
define exported symbol Pad_WKDebounceConfig = 0x0001148d;
define exported symbol Pad_WakeupEnableValue = 0x000114b3;
define exported symbol Pad_WakeupPolarityValue = 0x000114d9;
define exported symbol System_WakeUpPinEnable = 0x000114ff;
define exported symbol System_WakeUpPinDisable = 0x00011531;
define exported symbol Pad_WakeupInterruptValue = 0x0001154f;
define exported symbol System_WakeUpInterruptValue = 0x00011577;
define exported symbol Pad_ClearAllWakeupINT = 0x00011597;
define exported symbol Pad_OutputEnableValue = 0x000115f5;
define exported symbol Pad_OutputControlValue = 0x0001161b;
define exported symbol Pad_PullEnableValue = 0x00011641;
define exported symbol Pad_PullUpOrDownValue = 0x00011667;
define exported symbol Pad_ControlSelectValue = 0x0001168d;
define exported symbol Pad_ClearWakeupINTPendingBit = 0x000116b3;
define exported symbol Pad_PowerOrShutDownValue = 0x000116cb;
define exported symbol Pad_PullConfigValue = 0x000116f1;
define exported symbol RTC_WriteReg = 0x00011759;
define exported symbol RTC_DeInit = 0x00011795;
define exported symbol RTC_SetPrescaler = 0x00011815;
define exported symbol RTC_SetComp = 0x0001181d;
define exported symbol RTC_RunCmd = 0x00011827;
define exported symbol RTC_MaskINTConfig = 0x00011843;
define exported symbol RTC_CompINTConfig = 0x0001185f;
define exported symbol RTC_TickINTConfig = 0x0001187b;
define exported symbol RTC_GetINTStatus = 0x00011897;
define exported symbol RTC_SystemWakeupConfig = 0x000118ab;
define exported symbol WDG_ClockEnable = 0x000118d9;
define exported symbol WDG_Config = 0x00011903;
define exported symbol WDG_Enable = 0x00011931;
define exported symbol WDG_Disable = 0x00011943;
define exported symbol WDG_Restart = 0x00011955;
define exported symbol AON_WDG_Config = 0x00011a79;
define exported symbol AON_WDG_ConfigResetLevel = 0x00011acb;
define exported symbol AON_WDG_ConfigComp = 0x00011b0f;
define exported symbol AON_WDG_ConfigCntCtl = 0x00011b53;
define exported symbol AON_WDG_ConfigCntReload = 0x00011b97;
define exported symbol AON_WDG_Enable = 0x00011bdb;
define exported symbol AON_WDG_Disable = 0x00011c21;
define exported symbol AON_WDG_Restart = 0x00011c67;
define exported symbol AON_WDG_SystemReset = 0x00011c7f;
define exported symbol SPI_DeInit = 0x00011c95;
define exported symbol SPI_Init = 0x00011caf;
define exported symbol SPI_StructInit = 0x00011da3;
define exported symbol SPI_Cmd = 0x00011def;
define exported symbol SPI_SendBuffer = 0x00011e03;
define exported symbol SPI_SendWord = 0x00011e1f;
define exported symbol SPI_SendHalfWord = 0x00011e39;
define exported symbol SPI_INTConfig = 0x00011e55;
define exported symbol SPI_ClearINTPendingBit = 0x00011e69;
define exported symbol hci_if_open = 0x00013cc9;
define exported symbol hci_if_close = 0x00013ccd;
define exported symbol hci_if_write = 0x00013cd1;
define exported symbol hci_if_confirm = 0x00013cff;
define exported symbol sm_le_sc_local_oob_init = 0x0001808d;
define exported symbol sm_le_sc_peer_oob_init = 0x000180a1;
define exported symbol btif_send_cmd = 0x0000e6ab;
define exported symbol btif_buffer_get = 0x0002148f;
define exported symbol btif_buffer_put = 0x000214a9;
define exported symbol btif_vendor_cmd_req = 0x000214ed;
define exported symbol btif_just_work_req_cfm = 0x0002165b;
define exported symbol btif_sw_reset_req = 0x000216e3;
define exported symbol btif_le_disconn_cfm = 0x00021811;
define exported symbol btif_le_credit_based_conn_req = 0x00021e61;
define exported symbol btif_le_credit_based_conn_cfm = 0x00021eaf;
define exported symbol btif_le_credit_based_disconn_req = 0x00021f05;
define exported symbol btif_le_credit_based_disconn_cfm = 0x00021f23;
define exported symbol btif_le_send_credit_req = 0x00021f41;
define exported symbol btif_le_credit_based_data_req = 0x00021f63;
define exported symbol btif_le_credit_based_data_cfm = 0x00021f9d;
define exported symbol btif_le_credit_based_security_reg_req = 0x00021fbf;
define exported symbol btif_le_credit_based_psm_reg_req = 0x00021fed;
define exported symbol btif_le_gen_rand_addr = 0x000220f3;
define exported symbol btif_le_set_adv_set_rand_addr_req = 0x00022395;
define exported symbol btif_le_modify_adv_set_req = 0x000223bf;
define exported symbol btif_le_ext_adv_enable_req = 0x000223dd;
define exported symbol btif_le_ext_adv_param_set_req = 0x00022417;
define exported symbol btif_le_ext_adv_data_set_req = 0x0002248f;
define exported symbol btif_le_ext_scan_req = 0x00022503;
define exported symbol btif_le_ext_scan_param_set_req = 0x00022529;
define exported symbol btif_le_set_suppl_test_params_req = 0x0002257f;
define exported symbol btif_le_set_conn_suppl_params_req = 0x000225ab;
define exported symbol btif_le_conn_suppl_request_enable_req = 0x000225fb;
define exported symbol btif_le_conn_suppl_response_enable_req = 0x00022627;
define exported symbol btif_le_read_antenna_info_req = 0x00022645;
define exported symbol os_mem_alloc_intern = 0x00025d61;
define exported symbol os_mem_zalloc_intern = 0x00025db9;
define exported symbol os_mem_aligned_alloc_intern = 0x00025e17;
define exported symbol os_mem_free = 0x00025e77;
define exported symbol os_mem_aligned_free = 0x00025e95;
define exported symbol os_mem_peek = 0x00025eb3;
define exported symbol os_msg_queue_create_intern = 0x00025ef5;
define exported symbol os_msg_queue_delete_intern = 0x00025f51;
define exported symbol os_msg_queue_peek_intern = 0x00025f95;
define exported symbol os_msg_send_intern = 0x00025fe5;
define exported symbol os_msg_recv_intern = 0x00026045;
define exported symbol os_msg_peek_intern = 0x000260a3;
define exported symbol os_pool_create_intern = 0x000261e7;
define exported symbol os_pool_extend_intern = 0x000262bb;
define exported symbol os_pool_delete_intern = 0x0002638b;
define exported symbol os_buffer_get_intern = 0x0002645d;
define exported symbol os_buffer_put_intern = 0x00026561;
define exported symbol os_pool_dump = 0x000265e1;
define exported symbol os_queue_init = 0x0002666d;
define exported symbol os_queue_in = 0x00026677;
define exported symbol os_queue_out = 0x000266a3;
define exported symbol os_queue_peek = 0x000266d1;
define exported symbol os_queue_insert = 0x000266d5;
define exported symbol os_queue_delete = 0x0002670f;
define exported symbol os_delay = 0x00026771;
define exported symbol os_sys_time_get = 0x0002678f;
define exported symbol os_sys_tick_get = 0x000267a9;
define exported symbol os_sched_start = 0x000267c3;
define exported symbol os_sched_stop = 0x000267df;
define exported symbol os_sched_suspend = 0x000267fb;
define exported symbol os_sched_resume = 0x00026817;
define exported symbol os_lock = 0x00026851;
define exported symbol os_unlock = 0x0002686b;
define exported symbol os_sem_create = 0x00026889;
define exported symbol os_sem_delete = 0x000268b3;
define exported symbol os_sem_take = 0x000268d5;
define exported symbol os_sem_give = 0x000268fb;
define exported symbol os_mutex_create = 0x0002691d;
define exported symbol os_mutex_delete = 0x0002693f;
define exported symbol os_mutex_take = 0x00026961;
define exported symbol os_mutex_give = 0x00026987;
define exported symbol os_task_create = 0x000269d1;
define exported symbol os_task_delete = 0x00026a17;
define exported symbol os_task_suspend = 0x00026a39;
define exported symbol os_task_resume = 0x00026a5b;
define exported symbol os_task_yield = 0x00026a7d;
define exported symbol os_task_handle_get = 0x00026a99;
define exported symbol os_task_priority_get = 0x00026abb;
define exported symbol os_task_priority_set = 0x00026ae1;
define exported symbol os_task_signal_send = 0x00026b07;
define exported symbol os_task_signal_recv = 0x00026b2d;
define exported symbol os_task_signal_clear = 0x00026b53;
define exported symbol os_timer_id_get = 0x00026ba1;
define exported symbol os_timer_create = 0x00026bd7;
define exported symbol os_timer_start = 0x00026c1d;
define exported symbol os_timer_restart = 0x00026c3f;
define exported symbol os_timer_stop = 0x00026c65;
define exported symbol os_timer_delete = 0x00026c87;
define exported symbol os_timer_dump = 0x00026ca9;
define exported symbol os_timer_state_get = 0x00026cc5;
define exported symbol rtk_write_modem_radio_reg = 0x0002b11d;
define exported symbol rtk_read_modem_radio_reg = 0x0002b183;
define exported symbol hci_handle_le_receiver_test = 0x0002d321;
define exported symbol btaon_fast_read = 0x0003eded;
define exported symbol btaon_fast_read_safe = 0x0003ee05;
define exported symbol btaon_fast_write = 0x0003ee25;
define exported symbol btaon_fast_write_safe = 0x0003ee47;
define exported symbol btaon_fast_update = 0x0003ee73;
define exported symbol dfu_report_target_ic_type = 0x000474ab;
define exported symbol dfu_report_target_fw_info = 0x000474f5;
define exported symbol dfu_flash_erase = 0x000475a5;
define exported symbol dfu_update = 0x000475eb;
define exported symbol dfu_reset = 0x000476f5;
define exported symbol dfu_fw_active_reset = 0x00047713;
define exported symbol dfu_checkbufcrc = 0x0004776b;
define exported symbol dfu_flash_check_blank = 0x000477cb;
define exported symbol dfu_check_checksum = 0x00047833;
define exported symbol dfu_init = 0x00047a91;
define exported symbol dfu_switch_to_ota_mode = 0x00047ad7;
define exported symbol dfu_set_ota_mode_flag = 0x0004820d;
define exported symbol bt_crypto_f4 = 0x00048ac9;
define exported symbol ecc_make_key = 0x00049969;
define exported symbol gap_register_extend_cb = 0x0004be11;
define exported symbol gap_start_bt_stack = 0x0004be6b;
define exported symbol gap_set_pairable_mode = 0x0004bedb;
define exported symbol gap_handle_msg = 0x0004bf45;
define exported symbol gap_register_app_cb = 0x0004bfa5;
define exported symbol gap_set_param = 0x0004bfab;
define exported symbol gap_get_param = 0x0004c037;
define exported symbol gap_write_airplan_mode = 0x0004c0a5;
define exported symbol gap_read_airplan_mode = 0x0004c0c7;
define exported symbol gap_buffer_free = 0x0004c0e5;
define exported symbol le_bond_clear_all_keys = 0x0004c151;
define exported symbol le_bond_delete_by_idx = 0x0004c16d;
define exported symbol le_bond_delete_by_bd = 0x0004c1a7;
define exported symbol le_bond_set_param = 0x0004c1ef;
define exported symbol le_bond_get_param = 0x0004c2e1;
define exported symbol le_bond_pair = 0x0004c353;
define exported symbol le_bond_passkey_input_confirm = 0x0004c383;
define exported symbol le_bond_oob_input_confirm = 0x0004c3b7;
define exported symbol le_bond_get_display_key = 0x0004c3eb;
define exported symbol le_bond_user_confirm = 0x0004c415;
define exported symbol le_bond_passkey_display_confirm = 0x0004c475;
define exported symbol le_bond_keypress_notify = 0x0004c4a5;
define exported symbol le_bond_cfg_local_key_distribute = 0x0004c4d5;
define exported symbol le_gap_init = 0x0004cbbd;
define exported symbol le_gap_msg_info_way = 0x0004cc23;
define exported symbol le_load_upper_stack_efuse = 0x0004cc29;
define exported symbol le_get_max_link_num = 0x0004cc3b;
define exported symbol le_register_app_cb = 0x0004cc43;
define exported symbol le_set_gap_param = 0x0004cc49;
define exported symbol le_get_gap_param = 0x0004cd91;
define exported symbol le_modify_white_list = 0x0004ce55;
define exported symbol le_set_rand_addr = 0x0004ce75;
define exported symbol le_set_host_chann_classif = 0x0004ce93;
define exported symbol le_cfg_local_identity_address = 0x0004cea3;
define exported symbol le_write_default_data_len = 0x0004ceb3;
define exported symbol gap_send_dev_state = 0x0004cec3;
define exported symbol le_read_rssi = 0x0004cf2f;
define exported symbol le_read_chann_map = 0x0004cf59;
define exported symbol le_set_data_len = 0x0004cf83;
define exported symbol le_disable_slave_latency = 0x0004cfe9;
define exported symbol le_set_conn_tx_power = 0x0004d03f;
define exported symbol le_update_passed_chann_map = 0x0004d093;
define exported symbol le_vendor_set_rem_min_sca = 0x0004d0b9;
define exported symbol le_link_release = 0x0004d8d3;
define exported symbol le_link_find_by_link_id = 0x0004d8f5;
define exported symbol le_get_conn_id = 0x0004d9bb;
define exported symbol le_link_check_conn_id_internal = 0x0004da19;
define exported symbol le_get_conn_param = 0x0004da7f;
define exported symbol le_get_active_link_num = 0x0004db71;
define exported symbol le_get_idle_link_num = 0x0004db75;
define exported symbol le_get_conn_info = 0x0004db79;
define exported symbol le_get_conn_addr = 0x0004dbef;
define exported symbol le_disconnect = 0x0004dc25;
define exported symbol le_update_conn_param = 0x0004dc8b;
define exported symbol le_set_conn_param = 0x0004dccf;
define exported symbol le_connect = 0x0004dd79;
define exported symbol le_set_phy = 0x0004de43;
define exported symbol client_init = 0x0004e341;
define exported symbol client_register_general_client_cb = 0x0004e36f;
define exported symbol client_register_spec_client_cb = 0x0004e375;
define exported symbol client_all_primary_srv_discovery = 0x0004e4f5;
define exported symbol client_by_uuid_srv_discovery = 0x0004e529;
define exported symbol client_by_uuid128_srv_discovery = 0x0004e55f;
define exported symbol client_relationship_discovery = 0x0004e591;
define exported symbol client_all_char_discovery = 0x0004e5bf;
define exported symbol client_by_uuid_char_discovery = 0x0004e5fb;
define exported symbol client_by_uuid128_char_discovery = 0x0004e63d;
define exported symbol client_all_char_descriptor_discovery = 0x0004e685;
define exported symbol client_attr_read = 0x0004e6b3;
define exported symbol client_attr_read_using_uuid = 0x0004e70d;
define exported symbol client_attr_write = 0x0004e8a1;
define exported symbol client_attr_ind_confirm = 0x0004ea1f;
define exported symbol client_get_notify_data_buffer = 0x0004f29d;
define exported symbol client_handle_btif_msg = 0x0004f445;
define exported symbol server_builtin_service_reg = 0x0004f4f1;
define exported symbol server_init = 0x0004f505;
define exported symbol server_register_app_cb = 0x0004f537;
define exported symbol server_add_service = 0x0004f66f;
define exported symbol server_add_service_by_start_handle = 0x0004f681;
define exported symbol server_attr_read_confirm = 0x0004f693;
define exported symbol server_attr_write_confirm = 0x0004f731;
define exported symbol server_exec_write_confirm = 0x0004f779;
define exported symbol server_send_data = 0x0004f7a5;
define exported symbol server_get_write_cmd_data_buffer = 0x0004fc1f;
define exported symbol le_find_key_entry = 0x0005018f;
define exported symbol le_find_key_entry_by_idx = 0x000502a1;
define exported symbol le_allocate_key_entry = 0x000502c1;
define exported symbol le_get_bond_dev_num = 0x00050323;
define exported symbol le_set_high_priority_bond = 0x00050329;
define exported symbol le_get_high_priority_bond = 0x00050341;
define exported symbol le_get_key = 0x00050365;
define exported symbol le_save_key = 0x00050427;
define exported symbol le_get_low_priority_bond = 0x000507a1;
define exported symbol le_get_cccd_data = 0x000507c1;
define exported symbol le_find_entry_by_aes = 0x0005084f;
define exported symbol le_resolve_random_address = 0x000509d5;
define exported symbol le_gen_bond_dev = 0x00050a59;
define exported symbol le_set_privacy_info = 0x00050b05;
define exported symbol le_get_privacy_info = 0x00050b7b;
define exported symbol bond_priority_queue_add = 0x00050e1b;
define exported symbol imp_flash_save = 0x00050fe9;
define exported symbol imp_flash_load = 0x00051029;
define exported symbol flash_save_local_name = 0x00051071;
define exported symbol flash_load_local_name = 0x0005108f;
define exported symbol flash_save_local_appearance = 0x000510af;
define exported symbol flash_load_local_appearance = 0x000510d1;
define exported symbol flash_save_local_irk = 0x000510f3;
define exported symbol flash_load_local_irk = 0x00051115;
define exported symbol flash_load_le_remote_bd = 0x000511d1;
define exported symbol flash_load_le_local_ltk = 0x00051255;
define exported symbol flash_load_le_remote_ltk = 0x000512e7;
define exported symbol flash_load_le_remote_irk = 0x000513c3;
define exported symbol flash_load_le_local_csrk = 0x00051555;
define exported symbol flash_load_le_remote_csrk = 0x0005162f;
define exported symbol flash_read_le_cccd_length = 0x00051719;
define exported symbol gaps_set_parameter = 0x000518a1;
define exported symbol gaps_set_peripheral_preferred_conn_param = 0x0005193d;
define exported symbol gatts_service_changed_indicate = 0x0005195f;
define exported symbol gatt_register_callback = 0x00051ac3;
define exported symbol le_privacy_set_param = 0x00051b3d;
define exported symbol le_privacy_get_param = 0x00051b91;
define exported symbol le_privacy_register_cb = 0x00051bf1;
define exported symbol le_privacy_set_addr_resolution = 0x00051bf7;
define exported symbol le_privacy_read_peer_resolv_addr = 0x00051c77;
define exported symbol le_privacy_read_local_resolv_addr = 0x00051c87;
define exported symbol le_privacy_set_resolv_priv_addr_timeout = 0x00051c97;
define exported symbol le_privacy_modify_resolv_list = 0x00051cab;
define exported symbol le_privacy_set_mode = 0x00051d63;
define exported symbol le_privacy_convert_addr_type = 0x00051d73;
define exported symbol le_adv_set_param = 0x00051e91;
define exported symbol le_adv_get_param = 0x00051f95;
define exported symbol le_adv_read_tx_power = 0x0005202b;
define exported symbol le_adv_start = 0x000520c7;
define exported symbol le_adv_update_param = 0x0005213d;
define exported symbol le_adv_stop = 0x0005218b;
define exported symbol le_adv_set_tx_power = 0x000521d3;
define exported symbol le_vendor_one_shot_adv = 0x000521f9;
define exported symbol le_scan_set_param = 0x00052375;
define exported symbol le_scan_get_param = 0x00052409;
define exported symbol le_scan_start = 0x00052475;
define exported symbol le_scan_stop = 0x000524d3;
define exported symbol gap_send_msg_to_app = 0x00052601;
define exported symbol gap_send_conn_state_msg = 0x0005269b;
define exported symbol le_dtm_receiver_test = 0x0005289d;
define exported symbol le_dtm_transmitter_test = 0x000528ad;
define exported symbol le_dtm_test_end = 0x000528bd;
define exported symbol le_dtm_enhanced_receiver_test = 0x000528cd;
define exported symbol le_dtm_enhanced_transmitter_test = 0x000528dd;
define exported symbol vsnprintf = 0x00059911;
define exported symbol setlocale = 0x00059df5;
define exported symbol memcmp = 0x00059e05;
define exported symbol strlen = 0x00059e5d;
define exported symbol __aeabi_memcpy = 0x00059e9b;
define exported symbol __rt_memcpy = 0x00059e9b;
define exported symbol __aeabi_memcpy4 = 0x00059fa9;
define exported symbol __aeabi_memcpy8 = 0x00059fa9;
define exported symbol __aeabi_memset = 0x0005a00d;
define exported symbol __aeabi_memclr = 0x0005a01d;
define exported symbol __rt_memclr = 0x0005a01d;
define exported symbol _memset = 0x0005a021;
define exported symbol __aeabi_memclr4 = 0x0005a061;
define exported symbol __aeabi_memclr8 = 0x0005a061;
define exported symbol __rt_memclr_w = 0x0005a061;
define exported symbol _memset_w = 0x0005a065;
define exported symbol exit = 0x0005ae25;
define exported symbol strcmp = 0x0005ae39;
define exported symbol SystemCpuClock = 0x002000f4;
define exported symbol platform_delay_us = 0x00200154;
define exported symbol platform_delay_ms = 0x00200158;
define exported symbol otp = 0x00200164;
define exported symbol flash_lock_flag = 0x002004f9;
define exported symbol platform_seed = 0x00200504;
define exported symbol platform_poly = 0x00200508;
define exported symbol rand_gen_init = 0x0020050c;
define exported symbol rand_gen_read_random_number = 0x00200510;
define exported symbol rand_gen_reset = 0x00200514;
define exported symbol rtk_read_modem_radio_reg_pi = 0x002005c0;
define exported symbol rtk_write_modem_radio_reg_pi = 0x002005c4;
define exported symbol rtk_update_rfc_reg_pi = 0x002005ec;
define exported symbol phy_auto_gated_on = 0x0020094c;
define exported symbol phy_auto_gated_off = 0x00200950;
define exported symbol app_pre_main = 0x00200c38;
define exported symbol app_main = 0x00200c3c;
define exported symbol log_seq_num = 0x00200c50;
define exported symbol is_log_init = 0x00200c52;
define exported symbol DlpsErrorCode = 0x00200c7c;
define exported symbol DlpsRefuseReason = 0x00200c80;
define exported symbol g_BasePri = 0x00200cac;
define exported symbol flash_device_info = 0x00200cb0;
define exported symbol flash_erase_enter = 0x00200ce8;
define exported symbol flash_erase_exit = 0x00200cec;
define exported symbol flash_split_read_info = 0x00200d04;
define exported symbol flash_dma_cfg = 0x00200d1c;
define exported symbol flash_sem = 0x00200d40; 
define exported symbol xTickCount = 0x00200d5c;
define exported symbol pTaskHandleList = 0x00200d80;
define exported symbol xTimerQueue = 0x00200e58;
define exported symbol xFreeBytesRemaining = 0x00200ebc;
define exported symbol xMinimumEverFreeBytesRemaining = 0x00200ec4;
define exported symbol xHeapTotalSize = 0x00200ecc;
define exported symbol xStart = 0x00200ed4;
define exported symbol patch_osif_os_sys_time_get = 0x0020110c;
define exported symbol patch_osif_os_task_signal_send = 0x00201144;
define exported symbol patch_osif_os_msg_send_intern = 0x00201184;
define exported symbol patch_osif_os_timer_create = 0x002011d4;
define exported symbol Patch_Dump_CPU_Register_and_Memory = 0x00201214;
define exported symbol patch_vTaskSwitchContext = 0x00201238;
define exported symbol patch_HardFaultRecord_TryToSave = 0x002013dc;
define exported symbol gap_common_app_cb = 0x00202df4;
define exported symbol gap_device_state = 0x00202e38;
define exported symbol gap_param_ds_pool_id = 0x00202e44;
define exported symbol gap_param_ds_data_offset = 0x00202e46;
define exported symbol gap_app_cb = 0x00202e48;
define exported symbol gap_link_credits = 0x00202e60;
define exported symbol gap_link_table = 0x00202e64;
define exported symbol bond_storage_num = 0x00202ebc;
define exported symbol le_fs_remote_bd_offset = 0x00202ee0;
define exported symbol le_link_block_size = 0x00202eee;
define exported symbol le_fs_start_offset = 0x00202ef0;
